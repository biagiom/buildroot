## configs/acmesystems_arietta_g25_128mb_defconfig
```kconfig
# Architecture
BR2_arm=y

# Kernel header
BR2_PACKAGE_HOST_LINUX_HEADERS_CUSTOM_4_4=y

# Toolchain
BR2_TOOLCHAIN_BUILDROOT_GLIBC=y
BR2_TOOLCHAIN_BUILDROOT_CXX=y

# System configuration
BR2_TARGET_GENERIC_HOSTNAME="arietta"
BR2_TARGET_GENERIC_ISSUE="Welcome to Arietta-G25 Buildroot !"
BR2_TARGET_GENERIC_ROOT_PASSWD="acmesystems"
BR2_TARGET_GENERIC_GETTY_PORT="ttyS0"
BR2_TARGET_GENERIC_GETTY_BAUDRATE_115200=y
BR2_ROOTFS_OVERLAY="board/acmesystems/arietta-g25/rootfs-overlay"
BR2_ROOTFS_POST_BUILD_SCRIPT="board/acmesystems/arietta-g25/post-build.sh"
BR2_ROOTFS_POST_IMAGE_SCRIPT="board/acmesystems/arietta-g25/post-image.sh"

# Kernel
BR2_LINUX_KERNEL=y
BR2_LINUX_KERNEL_CUSTOM_VERSION=y
BR2_LINUX_KERNEL_CUSTOM_VERSION_VALUE="4.4.16"
BR2_LINUX_KERNEL_PATCH="board/acmesystems/arietta-g25/patches/linux/linux-4.4.16-arietta.patch"
BR2_LINUX_KERNEL_DEFCONFIG="acme-arietta"
BR2_LINUX_KERNEL_DTS_SUPPORT=y
BR2_LINUX_KERNEL_INTREE_DTS_NAME="acme-arietta"

# Root filesystem configuration
BR2_TARGET_ROOTFS_EXT2=y
BR2_TARGET_ROOTFS_EXT2_4=y
BR2_TARGET_ROOTFS_EXT2_LABEL="rootfs"

# AT91bootstrap bootloader
BR2_TARGET_AT91BOOTSTRAP3=y
BR2_TARGET_AT91BOOTSTRAP3_CUSTOM_GIT=y
BR2_TARGET_AT91BOOTSTRAP3_CUSTOM_REPO_URL="https://github.com/biagiom/at91bootstrap.git"
BR2_TARGET_AT91BOOTSTRAP3_CUSTOM_REPO_VERSION="acmesystems-v1.0"
BR2_TARGET_AT91BOOTSTRAP3_DEFCONFIG="arietta-128m"

# Required tools to create the SD image
BR2_PACKAGE_HOST_DOSFSTOOLS=y
BR2_PACKAGE_HOST_GENIMAGE=y
BR2_PACKAGE_HOST_MTOOLS=y
```
